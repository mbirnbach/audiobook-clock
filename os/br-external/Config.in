## os/br-external/Config.in
```kconfig
source "$BR2_EXTERNAL_ABS_CLOCK_PATH/package/wmt-init/Config.in"
source "$BR2_EXTERNAL_ABS_CLOCK_PATH/package/nightstand/Config.in"
source "$BR2_EXTERNAL_ABS_CLOCK_PATH/package/x04g-utils/Config.in"
```

## os/br-external/configs/x04g_stock_defconfig
```kconfig
# Mi Smart Clock X04G on the stock Xiaomi kernel (MediaTek 4.14, 32-bit)
BR2_arm=y
BR2_cortex_a7=y
BR2_ARM_FPU_NEON_VFPV4=y
BR2_TOOLCHAIN_EXTERNAL=y
BR2_TOOLCHAIN_EXTERNAL_BOOTLIN=y
BR2_TOOLCHAIN_EXTERNAL_BOOTLIN_ARMV7_EABIHF_GLIBC_STABLE=y
BR2_TARGET_GENERIC_HOSTNAME="abs-clock"
BR2_TARGET_GENERIC_ISSUE="abs-clock"
BR2_TARGET_GENERIC_ROOT_PASSWD=""
BR2_SYSTEM_DHCP=""
BR2_TARGET_GENERIC_GETTY=n
BR2_ROOTFS_DEVICE_CREATION_DYNAMIC_MDEV=y
BR2_ROOTFS_OVERLAY="$(BR2_EXTERNAL_ABS_CLOCK_PATH)/board/x04g-stock/rootfs-overlay"
BR2_PACKAGE_BUSYBOX_SHOW_OTHERS=y
BR2_PACKAGE_DROPBEAR=y
BR2_PACKAGE_WPA_SUPPLICANT=y
BR2_PACKAGE_WPA_SUPPLICANT_NL80211=y
BR2_PACKAGE_WPA_SUPPLICANT_CLI=y
BR2_PACKAGE_WPA_SUPPLICANT_CTRL_IFACE=y
BR2_PACKAGE_IW=y
BR2_PACKAGE_WIRELESS_TOOLS=y
BR2_PACKAGE_WIRELESS_REGDB=y
BR2_PACKAGE_ALSA_UTILS=y
BR2_PACKAGE_ALSA_UTILS_APLAY=y
BR2_PACKAGE_ALSA_UTILS_AMIXER=y
BR2_PACKAGE_ALSA_UTILS_SPEAKER_TEST=y
BR2_PACKAGE_EVTEST=y
BR2_PACKAGE_I2C_TOOLS=y
BR2_PACKAGE_FB_TEST_APP=y
BR2_PACKAGE_STRACE=y
BR2_PACKAGE_KMOD=y
BR2_PACKAGE_KMOD_TOOLS=y
BR2_PACKAGE_WMT_INIT=y
BR2_TARGET_ROOTFS_CPIO=y
BR2_TARGET_ROOTFS_CPIO_GZIP=y
BR2_PACKAGE_X04G_UTILS=y
BR2_TARGET_ROOTFS_EXT2=y
BR2_TARGET_ROOTFS_EXT2_4=y
BR2_TARGET_ROOTFS_EXT2_LABEL="abs-root"
BR2_TARGET_ROOTFS_EXT2_SIZE="600M"
BR2_TARGET_ROOTFS_EXT2_RESBLKS=0

# Qt app
BR2_PACKAGE_QT6=y
BR2_PACKAGE_QT6BASE_CONCURRENT=y
BR2_PACKAGE_QT6BASE_GUI=y
BR2_PACKAGE_QT6TOOLS=y
BR2_PACKAGE_HOST_QT6TOOLS=y
BR2_PACKAGE_HOST_QT6TOOLS_LINGUIST_TOOLS=y
BR2_PACKAGE_QT6BASE_LINUXFB=y
BR2_PACKAGE_QT6BASE_DEFAULT_QPA="linuxfb"
BR2_PACKAGE_QT6BASE_NETWORK=y
BR2_PACKAGE_QT6BASE_JPEG=y
BR2_PACKAGE_QT6BASE_PNG=y
BR2_PACKAGE_QT6BASE_HARFBUZZ=y
BR2_PACKAGE_QT6DECLARATIVE=y
BR2_PACKAGE_QT6DECLARATIVE_QUICK=y
BR2_PACKAGE_QT6MULTIMEDIA=y
BR2_PACKAGE_QT6MULTIMEDIA_GSTREAMER=y
BR2_PACKAGE_QT6MULTIMEDIA_ALSA=y
BR2_PACKAGE_NIGHTSTAND=y
BR2_PACKAGE_CA_CERTIFICATES=y
# GStreamer: HTTP streaming, m4b/mp3/flac/opus, speed change (scaletempo)
BR2_PACKAGE_GSTREAMER1=y
BR2_PACKAGE_GST1_PLUGINS_BASE=y
BR2_PACKAGE_GST1_PLUGINS_BASE_PLUGIN_ALSA=y
BR2_PACKAGE_GST1_PLUGINS_BASE_PLUGIN_APP=y
BR2_PACKAGE_GST1_PLUGINS_BASE_PLUGIN_AUDIOCONVERT=y
BR2_PACKAGE_GST1_PLUGINS_BASE_PLUGIN_AUDIORESAMPLE=y
BR2_PACKAGE_GST1_PLUGINS_BASE_PLUGIN_PLAYBACK=y
BR2_PACKAGE_GST1_PLUGINS_BASE_PLUGIN_TYPEFIND=y
BR2_PACKAGE_GST1_PLUGINS_BASE_PLUGIN_VOLUME=y
BR2_PACKAGE_GST1_PLUGINS_BASE_PLUGIN_OGG=y
BR2_PACKAGE_GST1_PLUGINS_BASE_PLUGIN_OPUS=y
BR2_PACKAGE_GST1_PLUGINS_GOOD=y
BR2_PACKAGE_GST1_PLUGINS_GOOD_PLUGIN_SOUPHTTPSRC=y
BR2_PACKAGE_GST1_PLUGINS_GOOD_PLUGIN_ISOMP4=y
BR2_PACKAGE_GST1_PLUGINS_GOOD_PLUGIN_ID3DEMUX=y
BR2_PACKAGE_GST1_PLUGINS_GOOD_PLUGIN_APETAG=y
BR2_PACKAGE_GST1_PLUGINS_GOOD_PLUGIN_AUDIOPARSERS=y
BR2_PACKAGE_GST1_PLUGINS_GOOD_PLUGIN_AUTODETECT=y
BR2_PACKAGE_GST1_PLUGINS_GOOD_PLUGIN_AUDIOFX=y
BR2_PACKAGE_GST1_PLUGINS_GOOD_PLUGIN_MPG123=y
BR2_PACKAGE_GST1_PLUGINS_GOOD_PLUGIN_FLAC=y
BR2_PACKAGE_GST1_PLUGINS_BAD=y
BR2_PACKAGE_GST1_PLUGINS_BAD_PLUGIN_FAAD=y
# time: the app is a clock
BR2_TARGET_TZ_INFO=y
BR2_TARGET_LOCALTIME="Europe/Berlin"
BR2_PACKAGE_BUSYBOX_CONFIG_FRAGMENT_FILES="$(BR2_EXTERNAL_ABS_CLOCK_PATH)/board/x04g-stock/busybox-ntpd.fragment"
BR2_PACKAGE_E2FSPROGS=y

# The stock 4.14 kernel has no jitter entropy and the SoC no hwrng driver:
# without haveged getrandom() blocks for minutes after boot (Qt calls it at
# startup)
BR2_PACKAGE_HAVEGED=y
# Qt wants a UTF-8 locale
BR2_ENABLE_LOCALE_WHITELIST="C en_US C.UTF-8"
BR2_GENERATE_LOCALE="C.UTF-8"
```

## os/br-external/configs/x04g_test_defconfig
```kconfig
# Bring-up test image: rootfs as initramfs, kernel built separately for now
BR2_aarch64=y
BR2_cortex_a35=y
BR2_TOOLCHAIN_EXTERNAL=y
BR2_TOOLCHAIN_EXTERNAL_BOOTLIN=y
BR2_TOOLCHAIN_EXTERNAL_BOOTLIN_AARCH64_GLIBC_STABLE=y
BR2_TARGET_GENERIC_HOSTNAME="abs-clock"
BR2_TARGET_GENERIC_ISSUE="abs-clock bring-up"
BR2_TARGET_GENERIC_ROOT_PASSWD=""
BR2_SYSTEM_DHCP=""
BR2_TARGET_GENERIC_GETTY_PORT="ttyS0"
BR2_TARGET_GENERIC_GETTY_BAUDRATE_KEEP=y
BR2_ROOTFS_DEVICE_CREATION_DYNAMIC_MDEV=y
BR2_ROOTFS_OVERLAY="$(BR2_EXTERNAL_ABS_CLOCK_PATH)/board/x04g/rootfs-overlay"
BR2_PACKAGE_BUSYBOX_SHOW_OTHERS=y
BR2_PACKAGE_DROPBEAR=y
BR2_PACKAGE_WPA_SUPPLICANT=y
BR2_PACKAGE_WPA_SUPPLICANT_NL80211=y
BR2_PACKAGE_WPA_SUPPLICANT_CLI=y
BR2_PACKAGE_IW=y
BR2_PACKAGE_WIRELESS_TOOLS=y
BR2_PACKAGE_WIRELESS_REGDB=y
BR2_PACKAGE_ALSA_UTILS=y
BR2_PACKAGE_ALSA_UTILS_APLAY=y
BR2_PACKAGE_ALSA_UTILS_AMIXER=y
BR2_PACKAGE_ALSA_UTILS_SPEAKER_TEST=y
BR2_PACKAGE_EVTEST=y
BR2_PACKAGE_I2C_TOOLS=y
BR2_PACKAGE_LIBDRM=y
BR2_PACKAGE_LIBDRM_INSTALL_TESTS=y
BR2_PACKAGE_FB_TEST_APP=y
BR2_PACKAGE_LIBGPIOD=y
BR2_PACKAGE_LIBGPIOD_TOOLS=y
BR2_PACKAGE_STRACE=y
BR2_PACKAGE_KMOD=y
BR2_PACKAGE_KMOD_TOOLS=y
BR2_PACKAGE_IPERF3=y
BR2_TARGET_ROOTFS_CPIO=y
BR2_TARGET_ROOTFS_CPIO_GZIP=y
# BR2_TARGET_ROOTFS_TAR is not set
BR2_PACKAGE_WMT_INIT=y
# Qt app
BR2_PACKAGE_QT6=y
BR2_PACKAGE_QT6BASE_GUI=y
BR2_PACKAGE_QT6BASE_LINUXFB=y
BR2_PACKAGE_QT6BASE_DEFAULT_QPA="linuxfb"
BR2_PACKAGE_QT6BASE_NETWORK=y
BR2_PACKAGE_QT6BASE_JPEG=y
BR2_PACKAGE_QT6BASE_PNG=y
BR2_PACKAGE_QT6BASE_HARFBUZZ=y
BR2_PACKAGE_QT6DECLARATIVE=y
BR2_PACKAGE_QT6DECLARATIVE_QUICK=y
BR2_PACKAGE_QT6MULTIMEDIA=y
BR2_PACKAGE_QT6MULTIMEDIA_GSTREAMER=y
BR2_PACKAGE_QT6MULTIMEDIA_ALSA=y
BR2_PACKAGE_NIGHTSTAND=y
BR2_PACKAGE_CA_CERTIFICATES=y
# GStreamer: HTTP streaming, m4b/mp3/flac/opus, speed change (scaletempo)
BR2_PACKAGE_GSTREAMER1=y
BR2_PACKAGE_GST1_PLUGINS_BASE=y
BR2_PACKAGE_GST1_PLUGINS_BASE_PLUGIN_ALSA=y
BR2_PACKAGE_GST1_PLUGINS_BASE_PLUGIN_APP=y
BR2_PACKAGE_GST1_PLUGINS_BASE_PLUGIN_AUDIOCONVERT=y
BR2_PACKAGE_GST1_PLUGINS_BASE_PLUGIN_AUDIORESAMPLE=y
BR2_PACKAGE_GST1_PLUGINS_BASE_PLUGIN_PLAYBACK=y
BR2_PACKAGE_GST1_PLUGINS_BASE_PLUGIN_TYPEFIND=y
BR2_PACKAGE_GST1_PLUGINS_BASE_PLUGIN_VOLUME=y
BR2_PACKAGE_GST1_PLUGINS_BASE_PLUGIN_OGG=y
BR2_PACKAGE_GST1_PLUGINS_BASE_PLUGIN_OPUS=y
BR2_PACKAGE_GST1_PLUGINS_GOOD=y
BR2_PACKAGE_GST1_PLUGINS_GOOD_PLUGIN_SOUPHTTPSRC=y
BR2_PACKAGE_GST1_PLUGINS_GOOD_PLUGIN_ISOMP4=y
BR2_PACKAGE_GST1_PLUGINS_GOOD_PLUGIN_ID3DEMUX=y
BR2_PACKAGE_GST1_PLUGINS_GOOD_PLUGIN_APETAG=y
BR2_PACKAGE_GST1_PLUGINS_GOOD_PLUGIN_AUDIOPARSERS=y
BR2_PACKAGE_GST1_PLUGINS_GOOD_PLUGIN_AUTODETECT=y
BR2_PACKAGE_GST1_PLUGINS_GOOD_PLUGIN_AUDIOFX=y
BR2_PACKAGE_GST1_PLUGINS_GOOD_PLUGIN_MPG123=y
BR2_PACKAGE_GST1_PLUGINS_GOOD_PLUGIN_FLAC=y
BR2_PACKAGE_GST1_PLUGINS_BAD=y
BR2_PACKAGE_GST1_PLUGINS_BAD_PLUGIN_FAAD=y
```

## os/br-external/package/nightstand/Config.in
```kconfig
config BR2_PACKAGE_NIGHTSTAND
	bool "nightstand"
	depends on BR2_PACKAGE_QT6
	select BR2_PACKAGE_QT6BASE_GUI
	select BR2_PACKAGE_QT6BASE_NETWORK
	select BR2_PACKAGE_QT6DECLARATIVE
	select BR2_PACKAGE_QT6DECLARATIVE_QUICK
	select BR2_PACKAGE_QT6MULTIMEDIA
	select BR2_PACKAGE_QT6TOOLS
	select BR2_PACKAGE_HOST_QT6TOOLS_LINGUIST_TOOLS  # translations (i18n/)
	help
	  Audiobookshelf player UI for the Mi Smart Clock (app/ in this repo).
```

## os/br-external/package/wmt-init/Config.in
```kconfig
config BR2_PACKAGE_WMT_INIT
	bool "wmt-init"
	help
	  Brings up the MediaTek MT8167 CONNSYS Wi-Fi/BT block
	  (replaces Android's wmt_loader/wmt_launcher).
```

## os/br-external/package/x04g-utils/Config.in
```kconfig
config BR2_PACKAGE_X04G_UTILS
	bool "x04g-utils"
	help
	  Small helpers for the Mi Smart Clock: reboot2 (reboot with an
	  argument such as "bootloader").
```
